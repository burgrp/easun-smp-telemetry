## fw/components/drake-iot/Kconfig
```kconfig
menu "Drake IoT"

config DRAKE_IOT_HANDLE_WIFI
    bool "Handle WiFi (not working now)"
    default y
    help
        Handles WiFi connectivity.

endmenu
```

## fw/main/Kconfig.projbuild
```kconfig
menu "Example Configuration"

    config LED_GPIO
        int "LED GPIO pin"
        range 0 32
        default 12
        help
            GPIO pin number for LED.

endmenu
```
